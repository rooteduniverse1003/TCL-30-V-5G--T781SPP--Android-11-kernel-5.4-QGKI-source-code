## arch/arm64/Kconfig.products
```kconfig
menu "Products selection"
config TCT_HOLI_COMMON
        bool "TCT COMMON"
        depends on ARCH_HOLI
        help
          Support for TCT COMMON device.

config TCT_HOLI_BREMENTF
        bool "TCT BREMENTF"
        depends on ARCH_HOLI
        help
          Support for TCT Brementf device.

##begin add by bo_liu for lcd tp gki
config TCT_LCD_TP_GKI_BREMENTF
        bool "TCT LCD TP GKI"
        depends on ARCH_HOLI
        help
          Support for TCT Brementf device.
##end add by bo_liu for lcd tp gki
#begin add by zhikui.li for gki
config TCT_GKI_TRANSFOMERVZW
         bool "TCT GKI"
         depends on ARCH_HOLI
         help
           Support for TCT TRANSFOMERVZW device.
#end add by zhikui.li for gki

config TCT_HOLI_TRANSFORMERVZW
        bool "TCT TRANSFORMERVZW"
        depends on ARCH_HOLI
        help
          Support for TCT transformervzw device.

config TCT_HOLI_IRVINEVZW
        bool "TCT IRVINEVZW"
        depends on ARCH_HOLI
        help
          Support for TCT irvinevzw device.
#begin add by peisong.cao for lcd&tp 	  
config TCT_QGKI_IRVINEVZW
        bool "TCT QGKI IRVINEVZW"
        depends on ARCH_HOLI
        help
          Support for TCT irvinevzw device.
#end add by peisong.cao for lcd&tp 
config TCT_HOLI_BREMENVISIBLE
        bool "TCT BREMENVISIBLE"
        depends on ARCH_HOLI
        help
          Support for TCT bremenvisible device.

endmenu
```

## drivers/input/aw96103_sar/Kconfig
```kconfig
#
# Mediatek AW96103 Driver
#

config AW96103_SAR
	tristate "Awinic AW96103_Sar driver"
	depends on I2C
	default n
	help
	  Say Y here if you have Awinic AW96103_Sar controller
	  chip in your system.
	  If unsure, say N.
	  To compile this driver as a module, choose M here: the
	  module will be called AW96103_Sar key.

config TCT_TRANSFORMERVZW_SAR
	tristate "Awinic AW96103_Sar driver"
	depends on I2C
	default n
	help
	  Say Y here if you have Awinic AW96103_Sar controller
	  chip in your system.
	  If unsure, say N.
	  To compile this driver as a module, choose M here: the
	  module will be called AW96103_Sar key.
```

## drivers/input/aw96105_sar/Kconfig
```kconfig
#
# Mediatek AW96105 Driver
#

config AW96105_SAR
	tristate "Awinic AW96105_Sar driver"
	depends on I2C
	default n
	help
	  Say Y here if you have Awinic AW96105_Sar controller
	  chip in your system.
	  If unsure, say N.
	  To compile this driver as a module, choose M here: the
	  module will be called AW96105_Sar key.
```

## drivers/input/focaltech_transformervzw/Kconfig
```kconfig
#
# Configuration for FOCALFP_FINGERPRINT
#
config FOCALFP_FINGERPRINT
	tristate "FocalFp Fingerprint"
	default n
	help
	  If you say Y to this option, support will be included for
	  the FocalTech's fingerprint sensor. This driver supports
	  both REE and TEE. If in REE, CONFIG_SPI_SPIDEV must be set
	  to use the standard 'spidev' driver
	  
	  This driver can also be built as a module. If so, the module
	  will be called 'focaltech_fp'.
```

## drivers/input/hall/Kconfig
```kconfig
config TCT_HALL_SWITCH
	bool "TCT HALL SWITCH"
	default n
	help
	  If this option is set,it will support tct hall switch.
```

## drivers/input/sunwave_irvinevzw/Kconfig
```kconfig
config SUNWAVE_FP_IRVINEVZW
       tristate "Sunwave Fingerprint"
       default n
       help
          SUNWAVECORP Fingerprint
```

## drivers/input/touchscreen/focaltech_touch_ft8756_irvinevzw/Kconfig
```kconfig
#
# Focaltech Touchscreen driver configuration
#

config TOUCHSCREEN_IRVINE_VZW_FT8756 
    tristate "Focaltech Touchscreen FT8756 of BREMEN_TF"
    default n
    help
      Say Y here if you have Focaltech touch panel.
      If unsure, say N.
      
config TOUCHSCREEN_FTS_DIRECTORY_IRVINE_VZW_FT8756
    string "Focaltech ts directory name"
    default "focaltech_touch"
    depends on TOUCHSCREEN_BREMEN_TF_FT8756
```

## drivers/input/touchscreen/nt36523/Kconfig
```kconfig
#
# Novatek NT36xxx touchscreen driver configuration
#
config TOUCHSCREEN_NT36523_I2C
	bool "Novatek NT36523"
	default n
	depends on I2C
	help
	  Say Y here if you have a Novatek NT36523 touchscreen connected
	  to your system.

	  If unsure, say N.
```

## drivers/misc/tct-printk/Kconfig
```kconfig
config TCT_PRINTK_UART_CONSOLE
	bool "TCT printk UART controller"
	depends on ARCH_MSM || ARCH_QCOM
	help
	  MTK_PRINTK_UART_CONSOLE which is used to control whether to
	  control printk to uart console.  when boot up finish
	  uart console do not output printk log.
	  also RD can set the setting by command.
```

## drivers/misc/tct/Kconfig
```kconfig
menuconfig TCT_MISC_DRIVER
	bool "TCT misc driver support"
	default y
	---help---
	  This option add tct misc driver support.

if TCT_MISC_DRIVER

config TCT_DEBUG_SAVE_BOOT_MSG
	default y
	bool "TCT debug: saving kernel log of booting to memory"
	---help---
	  file node:/proc/bootmsg

endif

config TCT_UI_TURBO
	bool "ui turbo v1.0"
	default n

config TCT_STAT
	bool "tct statistics driver"
	depends on TCT_UI_TURBO
	default y

config TCT_PERF
	bool "tct performance driver"
	depends on TCT_UI_TURBO
	default y
```

## drivers/tct_debug/Kconfig
```kconfig
#
# TCT_DEBUG_KLOG configuration.
#
config TCT_DEBUG_KLOG
	depends on ARCH_MSM || ARCH_QCOM
	tristate "print kernel log to userspace by netlink."
	---help---
	  print kernel log to userspace by netlink.
```
